## drivers/input/fingerprint/fpc_oxygen/Kconfig
```kconfig
config FINGERPRINT_FPC1020_OXYGEN
	tristate "FingerPrint Cards fingerprint driver support"
	depends on INPUT_FINGERPRINT
	help
	  Say Y here to enable fpc fingerprint driver support!
```
